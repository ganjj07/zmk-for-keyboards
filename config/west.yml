## config/west.yml
```yaml
manifest:
  defaults:
    revision: v0.3
  remotes:
    - name: zmkfirmware
      url-base: https://github.com/zmkfirmware
    - name: petejohanson
      url-base: https://github.com/petejohanson
    - name: ReFil
      url-base: https://github.com/ReFil
    - name: tobiasarndt
      url-base: https://github.com/tobiasarndt
    - name: infused-kim
      url-base: https://github.com/infused-kim
  projects:
    - name: zmk
      remote: ReFil
      revision: split-data-xfer
      import: app/west.yml
  self:
    path: config
```
